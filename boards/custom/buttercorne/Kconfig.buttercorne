## boards/custom/buttercorne/Kconfig.buttercorne
```kconfig
# SPDX-License-Identifier: MIT

config BOARD_BUTTERCORNE
    select SOC_NRF52840_QIAA
    select ZMK_BOARD_COMPAT
```

## boards/custom/buttercorne/buttercorne_defconfig
```kconfig
# SPDX-License-Identifier: MIT

# ARM MPU and pinctrl (required by nRF52840 Zephyr SoC driver)
CONFIG_ARM_MPU=y
CONFIG_HW_STACK_PROTECTION=y
CONFIG_PINCTRL=y

# GPIO
CONFIG_GPIO=y

# P0.09 (matrix row 2) is an NFC antenna pin on nRF52840. Enable it as GPIO.
# Equivalent to embassy-nrf's "nfc-pins-as-gpio" feature used by the RMK firmware.
CONFIG_NFCT_PINS_AS_GPIOS=y

# Place firmware at code_partition for bootloader compatibility
CONFIG_USE_DT_CODE_PARTITION=y

# Generate .uf2 output for drag-and-drop flashing via Adafruit bootloader
CONFIG_BUILD_OUTPUT_UF2=y

# Flash + NVS settings storage (required for ZMK BLE bond persistence)
CONFIG_MPU_ALLOW_FLASH_WRITE=y
CONFIG_FLASH=y
CONFIG_FLASH_PAGE_LAYOUT=y
CONFIG_FLASH_MAP=y
CONFIG_NVS=y
CONFIG_SETTINGS_NVS=y
```
